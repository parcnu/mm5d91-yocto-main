## conf/bblayers.conf
```bitbake
# POKY_BBLAYERS_CONF_VERSION is increased each time build/conf/bblayers.conf
# changes incompatibly
POKY_BBLAYERS_CONF_VERSION = "2"

BBPATH = "${TOPDIR}"
BBFILES ?= ""

BBLAYERS ?= " \
  /home/truesense/extvol/source/poky/meta \
  /home/truesense/extvol/source/poky/meta-poky \
  /home/truesense/extvol/source/poky/meta-yocto-bsp \
  /home/truesense/extvol/source/meta-raspberrypi \
  /home/truesense/extvol/source/meta-openembedded/meta-oe \
  /home/truesense/extvol/source/meta-openembedded/meta-multimedia \
  /home/truesense/extvol/source/meta-openembedded/meta-networking \
  /home/truesense/extvol/source/meta-openembedded/meta-python \
  /home/truesense/extvol/source/meta-mm5d91-module \
  /home/truesense/extvol/source/meta-mm5d91-gui \
  /home/truesense/extvol/source/meta-mm5d91-dts \
  "
```
